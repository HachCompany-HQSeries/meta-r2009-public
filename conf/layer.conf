## conf/layer.conf
```bitbake
# We have a conf and classes directory, add to BBPATH
BBPATH .= ":${LAYERDIR}"

# We have a packages directory, add to BBFILES
BBFILES += "${LAYERDIR}/recipes-*/*/*.bb \
            ${LAYERDIR}/recipes-*/*/*.bbappend"

# Public layer definition.
BBFILE_COLLECTIONS += "meta-r2009-public"
BBFILE_PATTERN_meta-r2009-public := "^${LAYERDIR}/"

# Variscite layer 'variscite-fslc' priority is 9 as well.
BBFILE_PRIORITY_meta-r2009-public = "9"

# Currently we only supporting Yocto Dunfell.
LAYERSERIES_COMPAT_meta-r2009-public = "dunfell"

# HACH public layer depends and inherit from Variscite layer so that we can continue extending all Variscite custom stuf for their SOM to our career board. Goal is to not to duplicate work in our meta layer.
LAYERDEPENDS_custom = "variscite-fslc"

# Add Dynamic layer here so that bitbake can detect SWU update images either from public or private layes. 
# NOTE: We can remove virtualization layer later if we are not going to use it.
BBFILES_DYNAMIC += " \
    qt5-layer:${LAYERDIR}/dynamic-layers/qt5-layer/*/*/*.bb \
    qt5-layer:${LAYERDIR}/dynamic-layers/qt5-layer/*/*/*.bbappend \
    \
    swupdate:${LAYERDIR}/dynamic-layers/swupdate/*.bb \
    swupdate:${LAYERDIR}/dynamic-layers/swupdate/*.bbappend \
    \
    virtualization-layer:${LAYERDIR}/dynamic-layers/virtualization/*/*/*.bb \
    virtualization-layer:${LAYERDIR}/dynamic-layers/virtualization/*/*/*.bbappend \
"
```
